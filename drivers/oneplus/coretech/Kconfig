## drivers/oneplus/coretech/Kconfig
```kconfig
config OPCHAIN
	default n
	bool "Oneplus CoreTech helper, used for opchain module"

config ADJ_CHAIN
	default n
	bool "Chain task adj for victim select"
	help
	 To chain task adj for any purpose

config HOUSTON
	default n
	bool "houston rocket play your temperature guard"
	help
	 Realtime temperature monitor
```
